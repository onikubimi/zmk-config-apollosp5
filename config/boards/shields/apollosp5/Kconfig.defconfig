## config/boards/shields/apollosp5/Kconfig.defconfig
```kconfig
if SHIELD_APOLLOSP5_RIGHT
config ZMK_KEYBOARD_NAME
    default "ApolloSP5"

config ZMK_SPLIT_ROLE_CENTRAL
    default y
endif

if SHIELD_APOLLOSP5_LEFT
config ZMK_SPLIT_ROLE_CENTRAL
    default n
endif

if SHIELD_APOLLOSP5_LEFT || SHIELD_APOLLOSP5_RIGHT
config ZMK_SPLIT
    default y
endif
```

## config/boards/shields/apollosp5/Kconfig.shield
```kconfig
config SHIELD_APOLLOSP5_LEFT
    def_bool $(shields_list_contains,apollosp5_left)

config SHIELD_APOLLOSP5_RIGHT
    def_bool $(shields_list_contains,apollosp5_right)
```
