#include "apollosp5.dtsi"

&default_transform {
    col-offset = <7>;
};

&kscan0 {
    row-gpios
        /* 2. 行側を「読み取り」に設定し、PULL_DOWN（通常は0V）にする */
        = <&gpio0 17 (GPIO_ACTIVE_HIGH | GPIO_PULL_DOWN)>
        , <&gpio0 20 (GPIO_ACTIVE_HIGH | GPIO_PULL_DOWN)>
        , <&gpio0 31 (GPIO_ACTIVE_HIGH | GPIO_PULL_DOWN)>
        , <&gpio0 29 (GPIO_ACTIVE_HIGH | GPIO_PULL_DOWN)>
        , <&gpio0 2  (GPIO_ACTIVE_HIGH | GPIO_PULL_DOWN)>;

    col-gpios
        /* 3. 列側を「出力（HIGH）」にする */
        = <&gpio0 9  GPIO_ACTIVE_HIGH>
        , <&gpio0 10 GPIO_ACTIVE_HIGH>
        , <&gpio1 11 GPIO_ACTIVE_HIGH>
        , <&gpio1 13 GPIO_ACTIVE_HIGH>
        , <&gpio1 15 GPIO_ACTIVE_HIGH>
        , <&gpio0 8  GPIO_ACTIVE_HIGH>
        , <&gpio0 6  GPIO_ACTIVE_HIGH>;
};

    /* 右側のピンを正しく指定（左側と被らないように） */
    &right_encoder {
        status = "okay";
        a-gpios = <&gpio0 24 (GPIO_ACTIVE_LOW | GPIO_PULL_UP)>; // 右側の実際のピンに
        b-gpios = <&gpio0 11 (GPIO_ACTIVE_LOW | GPIO_PULL_UP)>; // 右側の実際のピンに
    };

    /* 重要：右側ビルドでは、右側のエンコーダーだけをセンサーとして認識させる */
    &sensors {
        sensors = <&right_encoder>;
    };
