#include "apollosp5.dtsi"

&kscan0 {
    /* 行(Row)の定義：Row 5 (P1.06) を追加 */
    row-gpios
        = <&gpio0 17 (GPIO_ACTIVE_LOW | GPIO_PULL_UP)> // Row 0
        , <&gpio0 20 (GPIO_ACTIVE_LOW | GPIO_PULL_UP)> // Row 1
        , <&gpio0 31 (GPIO_ACTIVE_LOW | GPIO_PULL_UP)> // Row 2
        , <&gpio0 29 (GPIO_ACTIVE_LOW | GPIO_PULL_UP)> // Row 3
        , <&gpio0 2  (GPIO_ACTIVE_LOW | GPIO_PULL_UP)> // Row 4
        , <&gpio1 6  (GPIO_ACTIVE_HIGH | GPIO_PULL_DOWN)>; // Row 5: Common (P1.06)

    /* 列(Column)の定義：既存の7本に、5way用の5本(A, B, C, D, Center)を追加 */
    col-gpios
        = <&gpio0 6  GPIO_ACTIVE_LOW> // Col 0
        , <&gpio0 8  GPIO_ACTIVE_LOW> // Col 1
        , <&gpio1 15 GPIO_ACTIVE_LOW> // Col 2
        , <&gpio1 13 GPIO_ACTIVE_LOW> // Col 3
        , <&gpio1 11 GPIO_ACTIVE_LOW> // Col 4
        , <&gpio0 10 GPIO_ACTIVE_LOW> // Col 5
        , <&gpio0 9  GPIO_ACTIVE_LOW> // Col 6
        /* ここから5way用 (Col 7〜11) */
        , <&gpio0 24 GPIO_ACTIVE_HIGH> // Col 7: A (024)
        , <&gpio1 0  GPIO_ACTIVE_HIGH> // Col 8: B (100)
        , <&gpio0 11 GPIO_ACTIVE_HIGH> // Col 9: C (011)
        , <&gpio1 4  GPIO_ACTIVE_HIGH> // Col 10: D (104)
        , <&gpio0 22 GPIO_ACTIVE_HIGH>; // Col 11: Center (022)
};
